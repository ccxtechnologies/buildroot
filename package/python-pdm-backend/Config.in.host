## package/python-pdm-backend/Config.in.host
```kconfig
config BR2_PACKAGE_HOST_PYTHON_PDM_BACKEND
	bool "host python-pdm-backend"
	help
	  This is the backend for PDM projects that is fully-compatible
	  with PEP 517 spec, but you can also use it alone. It reads the
	  metadata of PEP 621 format and coverts it to Core metadata.

	  https://backend.pdm-project.org/
```
